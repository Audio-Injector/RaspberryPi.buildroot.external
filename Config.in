## configs/raspberrypi_ai_defconfig
```kconfig
#inner ear simulator custom from here
BR2_DL_DIR="$(BASE_DIR)/../../buildroot.dl"
BR2_TOOLCHAIN_BUILDROOT_WCHAR=y

BR2_TARGET_ROOTFS_EXT2_SIZE="250M"

# package options
BR2_PACKAGE_FFTW_USE_NEON=y
BR2_PACKAGE_EIGEN_UNSUPPORTED_MODULES=y

# wifi
#BR2_PACKAGE_WPA_SUPPLICANT=y
#BR2_PACKAGE_RPI_WIFI_FIRMWARE=y

BR2_LINUX_KERNEL_IMAGE_TARGET_CUSTOM=y
BR2_LINUX_KERNEL_IMAGE_NAME="Image"
BR2_LINUX_KERNEL_IMAGE_TARGET_NAME="Image modules dtbs"
#BR2_LINUX_KERNEL_CONFIG_FRAGMENT_FILES="$(BR2_EXTERNAL)/configs/kernel.fragment"

BR2_PACKAGE_BUSYBOX_CONFIG_FRAGMENT_FILES="$(BR2_EXTERNAL)/configs/busybox.fragment"

BR2_ROOTFS_DEVICE_CREATION_DYNAMIC_EUDEV=y

#BR2_PACKAGE_RPI_USERLAND=y

# BR2_PACKAGE_NTP_NTPDATE
#BR2_PACKAGE_ALSA_UTILS=y
#BR2_PACKAGE_ALSA_UTILS_APLAY=y

# setup options
BR2_ROOTFS_OVERLAY="$(BR2_EXTERNAL)/overlays"
BR2_ROOTFS_USERS_TABLES="$(BR2_EXTERNAL)/users.txt"
BR2_ROOTFS_POST_IMAGE_SCRIPT="$(BASE_DIR)/build/post-image.sh"

# external packages
BR2_PACKAGE_OPENSSH=y
#BR2_PACKAGE_NTP=y
#BR2_PACKAGE_NTP_NTPDATE=y

# Audio
BR2_PACKAGE_ALSA_UTILS=y
BR2_PACKAGE_ALSA_UTILS_ALSAMIXER=y
BR2_PACKAGE_ALSA_UTILS_AMIXER=y
BR2_PACKAGE_ALSA_UTILS_APLAY=y

BR2_PACKAGE_GTKIOSTREAM=y
```

## configs/raspberrypi_ai_devicemode_defconfig
```kconfig
BR2_ROOTFS_OVERLAY="$(BR2_EXTERNAL)/board/raspberrypi0w/overlay"
BR2_TARGET_GENERIC_HOSTNAME="ai"

BR2_PACKAGE_UEMACS=y

BR2_INIT_SYSV=y

# dhcp
BR2_PACKAGE_DHCP=y
BR2_PACKAGE_DHCP_SERVER=y
```

## package/Config.in
```kconfig
menu "Packages"
source "$BR2_EXTERNAL_PI3_64BIT_PATH/package/gtkiostream/Config.in"
source "$BR2_EXTERNAL_PI3_64BIT_PATH/package/batterycontroller/Config.in"
endmenu
```

## package/batterycontroller/Config.in
```kconfig
config BR2_PACKAGE_BATTERYCONTROLLER
        bool "batterycontroller"
  select BR2_PACKAGE_NODEJS
  select BR2_PACKAGE_NODEJS_NPM
        help
          Micro-battery controller package

          Site to come
```
